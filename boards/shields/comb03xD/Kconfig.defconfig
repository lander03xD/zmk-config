## boards/shields/comb03xD/Kconfig.defconfig
```kconfig
# Required files for ZMK to recognize the shield

if COMB03XD

# Name must be less than 16 characters long!
config ZMK_KEYBOARD_NAME
    default "Comb03xD"

endif
```

## boards/shields/comb03xD/Kconfig.shield
```kconfig
# Required files for ZMK to recognize the shield

# No whitespace after the comma or in your keyboard name!
# Config name will be reused in Kconfig.defconfig
config COMB03XD
    def_bool $(shields_list_contains,comb03xD)
```

## boards/shields/fishKeeb/Kconfig.defconfig
```kconfig
if SHIELD_FISHKEEB

config ZMK_KEYBOARD_NAME 
    default "fishKeeb"
    
    
#sleep settings
config ZMK_SLEEP
    default y

config ZMK_IDLE_SLEEP_TIMEOUT
    default 120000

#BLE settings
config ZMK_BLE_EXPERIMENTAL_CONN
    default y

    
#zephyr ble settings
config BT_PERIPHERAL_PREF_TIMEOUT
    default 600
    
config BT_PERIPHERAL_PREF_MIN_INT
    default 12
    
config BT_PERIPHERAL_PREF_MAX_INT
    default 24
    
config BT_PERIPHERAL_PREF_LATENCY
    default 30


endif
```

## boards/shields/numer03xD/Kconfig.defconfig
```kconfig
if SHIELD_NUMER03XD

config ZMK_KEYBOARD_NAME 
    default "numer03xD"
    
#sleep settings
config ZMK_SLEEP
    default y

config ZMK_IDLE_SLEEP_TIMEOUT
    default 120000

endif
```

## boards/shields/splitFish/Kconfig.shield
```kconfig
# No whitespace after the comma or in your part name!
config SHIELD_SPLITFISH_LEFT
    def_bool $(shields_list_contains,splitfish_left)

# No whitespace after the comma or in your part name!
config SHIELD_SPLITFISH_RIGHT
    def_bool $(shields_list_contains,splitfish_right)
```

## boards/shields/sten03xD/Kconfig.defconfig
```kconfig
if SHIELD_STEN03xD_LEFT

# Name must be less than 16 characters long!
config ZMK_KEYBOARD_NAME
    default "Sten03xD"

config ZMK_SPLIT_ROLE_CENTRAL
    default y

endif

if SHIELD_STEN03XD_LEFT || SHIELD_STEN03XD_RIGHT

config ZMK_SPLIT
    default y

endif
```

## boards/shields/sten03xD/Kconfig.shield
```kconfig
# No whitespace after the comma or in your part name!
config SHIELD_STEN03XD_LEFT
    def_bool $(shields_list_contains,sten03xD_left)

# No whitespace after the comma or in your part name!
config SHIELD_STEN03XD_RIGHT
    def_bool $(shields_list_contains,sten03xD_right)
```
