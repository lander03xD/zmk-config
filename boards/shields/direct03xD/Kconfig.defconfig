## boards/shields/direct03xD/Kconfig.defconfig
```kconfig
if SHIELD_DIRECT03XD_LEFT

# Name must be less than 16 characters long!
config ZMK_KEYBOARD_NAME
    default "Direct03xD"

#currently central is the left side
config ZMK_SPLIT_ROLE_CENTRAL
    default y
    
config ZMK_SPLIT_BLE_CENTRAL_BATTERY_LEVEL_PROXY
    default y 

config ZMK_SPLIT_BLE_CENTRAL_BATTERY_LEVEL_FETCHING
    default y

endif

if SHIELD_DIRECT03XD_LEFT || SHIELD_DIRECT03XD_RIGHT

config ZMK_HID_KEYBOARD_REPORT_SIZE
    default 12

config ZMK_POINTING
    default y

config ZMK_SPLIT
    default y
    
#Enable deep sleep
config ZMK_SLEEP
    default y
    
#Enable quicker idle state at 15s instead of 30s
config ZMK_IDLE_TIMEOUT
    default 15000 
    
config ZMK_BLE_EXPERIMENTAL_CONN
    default y
    
choice BT_CTLR_TX_PWR
    default BT_CTLR_TX_PWR_MINUS_8
endchoice
    
config BT_PERIPHERAL_PREF_MIN_INT
    default 48
    
config BT_PERIPHERAL_PREF_MAX_INT
    default 80
    
config BT_PERIPHERAL_PREF_LATENCY 
    default 3

config BT_PERIPHERAL_PREF_TIMEOUT
    default 800
    
endif
```

## boards/shields/exp36/Kconfig.defconfig
```kconfig
if SHIELD_EXP36_LEFT

# Name must be less than 16 characters long!
config ZMK_KEYBOARD_NAME
    default "Exp36"

#currently central is the left side
config ZMK_SPLIT_ROLE_CENTRAL
    default y

endif

if SHIELD_EXP36_LEFT || SHIELD_EXP36_RIGHT

config ZMK_SPLIT
    default y
    
config ZMK_SLEEP
    default y

endif
	
```

## boards/shields/low3xD/Kconfig.defconfig
```kconfig
if SHIELD_LOW3XD_LEFT

# Name must be less than 16 characters long!
config ZMK_KEYBOARD_NAME
    default "Low3xD"

#currently central is the left side
config ZMK_SPLIT_ROLE_CENTRAL
    default y
    
config ZMK_SPLIT_BLE_CENTRAL_BATTERY_LEVEL_PROXY
    default y 

config ZMK_SPLIT_BLE_CENTRAL_BATTERY_LEVEL_FETCHING
    default y

endif

if SHIELD_LOW3XD_LEFT || SHIELD_LOW3XD_RIGHT

config ZMK_SPLIT
    default y
    
#sleep settings
#Idle
config ZMK_IDLE_TIMEOUT
    default 20000

#Deep sleep
config ZMK_SLEEP
    default y

config ZMK_IDLE_SLEEP_TIMEOUT
    default 3600000
    
endif
	
```

## boards/shields/mcuTester/Kconfig.defconfig
```kconfig
if SHIELD_MCUTESTER_LEFT

config ZMK_KEYBOARD_NAME
    default "McuTester"

config ZMK_SPLIT_ROLE_CENTRAL
    default y

endif

if SHIELD_MCUTESTER_LEFT || SHIELD_MCUTESTER_RIGHT

config ZMK_SPLIT
    default y
    
endif
	
```

## boards/shields/mcuTester/Kconfig.shield
```kconfig
config SHIELD_MCUTESTER_LEFT
    def_bool $(shields_list_contains,mcuTester_left)

config SHIELD_MCUTESTER_RIGHT
    def_bool $(shields_list_contains,mcuTester_right)
```

## boards/shields/moduleTester/Kconfig.defconfig
```kconfig
if SHIELD_MODULETESTER

config ZMK_KEYBOARD_NAME 
    default "ModuleTester"

endif
```

## boards/shields/orth03xD/Kconfig.defconfig
```kconfig
if SHIELD_ORTH03XD_LEFT

# Name must be less than 16 characters long!
config ZMK_KEYBOARD_NAME
    default "Orth03xD"

#currently central is the left side
config ZMK_SPLIT_ROLE_CENTRAL
    default y
    
config ZMK_SPLIT_BLE_CENTRAL_BATTERY_LEVEL_PROXY
    default y 

config ZMK_SPLIT_BLE_CENTRAL_BATTERY_LEVEL_FETCHING
    default y

endif

if SHIELD_ORTH03XD_LEFT || SHIELD_ORTH03XD_RIGHT

config ZMK_SPLIT
    default y
    
#sleep settings
#Idle
config ZMK_IDLE_TIMEOUT
    default 20000

#Deep sleep
config ZMK_SLEEP
    default y

config ZMK_IDLE_SLEEP_TIMEOUT
    default 3600000
    
endif
	
```

## boards/shields/tv03xD/Kconfig.defconfig
```kconfig
if SHIELD_TV03XD

# Name must be less than 16 characters long!
config ZMK_KEYBOARD_NAME
    default "TV03xD"
    
config ZMK_POINTING
    default y
    
#Enable deep sleep
config ZMK_SLEEP
    default y
    
    
config I2C
    default y

config INPUT_TPS43
    default y

config ZMK_POINTING
    default y
    
endif
```
