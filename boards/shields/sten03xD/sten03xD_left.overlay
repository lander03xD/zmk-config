#include "sten03xD.dtsi" // The shared dtsi file is included in the overlay

// Label of the kscan node in the dtsi
&kscan0 {
    col-gpios
        = <&xiao_d 2 GPIO_ACTIVE_HIGH>
        , <&xiao_d 3 GPIO_ACTIVE_HIGH>
        , <&xiao_d 4 GPIO_ACTIVE_HIGH>
        , <&xiao_d 5 GPIO_ACTIVE_HIGH>
        , <&xiao_d 6 GPIO_ACTIVE_HIGH>
        ;
};
