#include "sten03xD.dtsi" // The shared dtsi file is included in the overlay

// Label of the kscan node in the dtsi
&kscan0 {
    col-gpios
        = <&xiao_d 6 GPIO_ACTIVE_HIGH>
        , <&xiao_d 5 GPIO_ACTIVE_HIGH>
        , <&xiao_d 4 GPIO_ACTIVE_HIGH>
        , <&xiao_d 2 GPIO_ACTIVE_HIGH>
        , <&xiao_d 1 GPIO_ACTIVE_HIGH>
        , <&xiao_d 0 GPIO_ACTIVE_HIGH>
        ;
};

&default_transform { // Offset of 5 because the left side has 5 columns
    col-offset = <5>;
};
